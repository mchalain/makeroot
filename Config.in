## Config.in
```kconfig
# Config.in

config CONFIGNAME
    string "Definition Name"
    default "FHS_Linux_glibc_busybox"

config SHOW_ALL
    bool "display every configuration entries"

menu "target definition"

choice
    prompt "Harware Platform"
    config ARM
        bool "ARM Lt CPU"
    config MIPS
        bool "MIPS CPU"
endchoice

config ARCH
    string "CPU Architecture"
    default "mips" if MIPS
    default "arm" if ARM

if ARM
choice
    prompt "Board"
    default BOARD_SNOWBALL
    config BOARD_SNOWBALL
        bool "ST-Ericson Snowball"
        select LINARO
        select SUBARCH_V7A
        select HFP_CPU
        select GPU_MALI400
        help
			http://www.igloocommunity.org/

    config BOARD_ORIGEN
        bool "Samsung Origen Board"
        select LINARO
        select SUBARCH_V7A
         select HFP_CPU
       help
			http://www.origenboard.org
			https://wiki.linaro.org/Boards/Origen/Index

    config BOARD_VEXPRESS
        bool "Arm Lt V-Express"
        select LINARO
        select SUBARCH_V7A
        select HFP_CPU
        help
			http://www.arm.com/products/tools/development-boards/
			https://wiki.linaro.org/Boards/Vexpress

    config BOARD_BEAGLE
        bool "Texas Instrument Beagle Board"
        select LINARO
        select SUBARCH_V7A
        select HFP_CPU
        help
			https://wiki.linaro.org/Boards/BeagleBoardXM

    config BOARD_PANDA
        bool "Texas Instrument Pando Board"
        select LINARO
        select SUBARCH_V7A
        select HFP_CPU

    config BOARD_IMX51
        bool "Freescale DragonBall iMX51"
        select LINARO
        select SUBARCH_V7A
        select HFP_CPU

    config BOARD_OVERO
		bool "Gumstix Overo"
		select LINARO
        select SUBARCH_V7A
        select HFP_CPU
		help
			https://wiki.linaro.org/Boards/Overo
    config BOARD_MULTI
		bool "not specific board"
		help
			this entry allows to select the same module (example egl drivers)
			for different boards.

endchoice

config BOARD_NAME
    string
    prompt "Board name" if BOARD_MULTI
    default "snowball" if BOARD_SNOWBALL
    default "origen" if BOARD_ORIGEN
    default "vexpress" if BOARD_VEXPRESS
    default "beagle" if BOARD_BEAGLE
    default "panda" if BOARD_PANDA
    default "imx51" if BOARD_IMX51
    default "overo" if BOARD_OVERO

choice
	prompt "sub architecture definition"
	config SUBARCH_V4T
		bool "ARM v4T 7TDMI 9TDMI 920T 940T"
	config SUBARCH_V5TE
		bool "ARM v5TE 946E-S 966E-S 968E-S 1020E 1022E 1026EJ-S"
	config SUBARCH_V6
		bool "ARM v6 136J-S"
	config SUBARCH_V7M
		bool "ARM v7-A Cortex M3 M5"
	config SUBARCH_V7A
		bool "ARM v7-A Cortex A5 A7 A8 A9 A15"
		select HFP_CPU
	config SUBARCH_OTHER
		bool "Other ARM subarchitecture"
endchoice

config SUBARCH
	string
	prompt "ARM subarchitecture" if SUBARCH_OTHER
	default "armv4t" if SUBARCH_V4T
	default "armv5te" if SUBARCH_V5TE
	default "armv6" if SUBARCH_V6
	default "armv7-m" if SUBARCH_V7M
	default "armv7-a" if SUBARCH_V7A

config HFP_CPU
	bool "Hard Floating Point coprocessor"

config THUMB
	bool "build in Thumb format"
endif

config GCC_FLAGS
	string "GCC processor flags"
	default ""

config MALI
	bool
choice
	prompt "Graphics CoProcessor"
	config GPU_NONE
		bool "none"
	config GPU_MALI200
		bool "Mali 200 (ARM lt)"
		select MALI
	config GPU_MALI400
		bool "Mali 400 (ARM lt)"
		select MALI
	config GPU_ADRENO
		bool "Adreno (Qualcomm)"
endchoice

endmenu

source "tools/gcc/Config.in"

menu "Embedded System Build"

source "bootloader/Config.in"

source "tree/Config.in"

source "kernel/Config.in"

source "libc/Config.in"

source "env/Config.in"

source "system/Config.in"

comment  "Graphics screen support"
source "graphics/Config.in"

comment "Audio support"
source "audio/Config.in"

endmenu

source "image/Config.in"
```

## audio/Config.in
```kconfig
config ALSA
	bool "ALSA userland library"
	default y

config ALSA_UTILS
	bool "ALSA userland utils : amixer"
	depends on ALSA && NCURSES
	default n
	help
		need libncurses
config ALSA_TOOLS
	bool "ALSA specials tools"
	depends on ALSA
	default n

config PULSEAUDIO
	bool "PulseAudio the sound daemon"
	depends on ALSA
	default n
```

## bootloader/Config.in
```kconfig
menu "Bootloader configuration"
config U_IMAGE
    bool

choice
    prompt "bootloader"
    config U_BOOT
        bool "u-boot"
        select U_IMAGE
endchoice

config U_BOOT_VERSION
	string "u-boot version"
	depends on U_BOOT
	default "ux500" if BOARD_SNOWBALL

config U_BOOT_TARGET
	string "the SoC target name"
	depends on U_BOOT
	default BOARD_NAME

config U_BOOT_SCRIPT
	bool "u-boot script generation"
	depends on U_BOOT
	default y
endmenu
```

## env/Config.in
```kconfig
menu "Environment tools"
choice
    prompt "Environment selection"
    config BUSYBOX
        bool "busybox"
        default y
    config GNU
        bool "gnu"
    config DALVIK
        bool "Android Dalvik VM"
endchoice
endmenu
```

## graphics/Config.in
```kconfig
menuconfig GRAPHICS
    bool "Graphics screen support"

if GRAPHICS

config EGL
    bool

source "graphics/system/Config.in"

if DIRECTFB
source "graphics/directFB/Config.in"
endif

if X11
source "graphics/X11/Config.in"
endif

if WAYLAND
source "graphics/wayland/Config.in"
endif

endif
```

## graphics/egl/Config.in
```kconfig
comment "openGL support"
config EGL_GLEW
	bool "Linaro Graphics Miscellany"
	depends on LINARO

choice
	prompt "OpenGL ES 2 distribution"
	config EGL_MESA
		bool "Mesa3D OpenGL library"
		select DEV_UDEV
	config EGL_SUNXI_MALI
		bool "Sunxi Mali GLES2 prorietary librariesfor AllWinner"
		depends on MALI || BOARD_MULTI
		help
			http://linux-sunxi.org/Main_Page
	config EGL_SNOWBALL_MALI
		bool "Mali GLES2 prorietary libraries for snowball"
		depends on BOARD_SNOWBALL || BOARD_MULTI
		help
			http://linux-sunxi.org/Main_Page
endchoice

if EGL_MESA
comment "Mesa 3D configuration"
config EGL_MESA_OPTIONS
    string "mesa autogen options"
    default ""

# choice
# 	prompt "Gallium EGL driver"
# 	config EGL_LIMA
# 		bool "Lima EGL library for Mali (ARM tm) GPU"
# 		depends on GPU_MALI200 || GPU_MALI400 || BOARD_MULTI
# 
# 	config EGL_FREEDRENO
# 		bool "FreeDreno EGL library for Adreno (Qualcomm tm) GPU"
# 		depends on GPU_ADRENO || BOARD_MULTI
# 
# endchoice

endif
```

## graphics/system/Config.in
```kconfig
config FRAMEBUFFER
    bool
config EGL
	bool

choice
    prompt "Graphic System"

    config FRAMEBUFFER_ONLY
        bool "Frame Buffer  only"
        select FRAMEBUFFER
        
    config DIRECTFB
        bool "DirectFB"
        select FRAMEBUFFER

    config X11
        bool "X11 server"
        select FRAMEBUFFER

    config WAYLAND
        bool "Wayland"
        select LIBFFI
        select EXPAT
        select WAYLAND_LIB

endchoice

if WAYLAND
comment "Wayland configuration"

config WAYLAND_VERSION
    string "Wayland version"
    default "1.1.0"

choice
    prompt "Compositor"
    default WESTON

    config WESTON
        bool "Weston default Wayland Compositor"
        select LIBXKBCOMMON
        select LIBUNWIND
        select PIXMAN
        select EGL

endchoice

config WESTON_OPTIONS
    string "Weston autogen options"
    depends on WESTON
    default "--disable-libunwind" if !LIBUNWIND

endif

config LIBXKBCOMMON
    bool
    prompt  "libxkbcommon translating evdev keycodes to keysyms" if SHOW_ALL

if DIRECTFB
config DIRECTFB_MULTIAPPS
	bool "DirectFB with multi applications"
	default y
	select LINUX_FUSION
endif
```

## image/Config.in
```kconfig
menu "image generation"
config MMC_INFO
	bool
config FLASH_INFO
	bool
choice
    prompt "Image file"
    config IMAGE_MMC
        bool "mmc for u-boot"
        select MMC_INFO
    config IMAGE_EMMC
        bool "embedded mmc for u-boot"
        select FLASH_INFO
        select MMC_INFO
    config IMAGE_RAW
        select FLASH_INFO
        bool "raw image for flash memory"
    config IMAGE_QEMU
        bool "raw image for qemu"
endchoice

menuconfig BOOT_DISK
	bool "boot disk"

	config BOOT_DISK_PARTNUM
		int "boot partition number"
		depends on BOOT_DISK
		default 1

	config BOOT_SIZE
		int "fixed boot disk size in MiB"
		depends on BOOT_DISK
		default 50
		
	choice 
		prompt "boot files system type"
		depends on BOOT_DISK
		config BOOT_UBIFS
			bool "UbiFS"
		config BOOT_VFAT
			bool "vfat fs"
		config BOOT_MSDOS
			bool "msdos fs"
	endchoice
	config BOOT_FS
		string
		depends on BOOT_DISK
		default ubifs if BOOT_UBIFS
		default vfat if BOOT_VFAT
		default msdos if BOOT_MSDOS

	config BOOT_DEVICE
		string "device to create file system"
		depends on BOOT_DISK
		default "disk" if IMAGE_RAW
		default "mmc" if IMAGE_MMC
		default "request"

menuconfig ROOT_DISK
	bool "root disk"

	config ROOT_DISK_PARTNUM
		int "root partition number"
		depends on ROOT_DISK
		default 2

	config ROOT_SIZE
		int "fixed root disk size in MiB"
		depends on ROOT_DISK
		default 1024

	config ROOT_RO
		bool
		depends on ROOT_DISK
		prompt "Root file system is read only"
		
	choice 
		prompt "ROOT files system type"
		depends on ROOT_DISK
		config ROOT_UBIFS
			bool "UbiFS"
		config ROOT_EXT2
			bool "Ext2 fs"
		config ROOT_EXT4
			bool "Ext4 fs"
		config ROOT_SQUASH
			bool "Squashfs"
		config ROOT_YAFFS2
			bool "Yaffs2"
		config ROOT_CRAMFS
			bool "cram fs"
	endchoice
	config ROOT_FS
		string
		depends on ROOT_DISK
		default ubifs if ROOT_UBIFS
		default ext2 if ROOT_EXT2
		default ext4 if ROOT_EXT4
		default squashfs if ROOT_SQUASH
		default yaffs2 if ROOT_YAFFS2
		default cramfs if ROOT_CRAMFS

	config ROOT_DEVICE
		string "device to create file system"
		depends on ROOT_DISK
		default "disk" if IMAGE_RAW
		default "mmc" if IMAGE_MMC
		default "request"

menuconfig HOME_DISK
	bool "home independant fs"

	config HOME_SIZE
		int "fixed root disk size in MiB"
		depends on HOME_DISK
		default 1024
	choice 
		prompt "home files system type"
		depends on HOME_DISK
		config HOME_FAT32
			bool "Fat32 fs"
		config HOME_EXT2
			bool "Ext2 fs"
		config HOME_EXT4
			bool "Ext4 fs"
	endchoice
	config HOME_FS
		string
		depends on HOME_DISK
		default vfat if HOME_FAT32
		default ext2 if HOME_EXT2
		default ext4 if HOME_EXT4

	config HOME_DEVICE
		string "device to create file system"
		depends on HOME_DISK
		default "disk" if IMAGE_RAW
		default "request"

if FLASH_INFO
menu "Flash description"
    config MTD_PAGESIZE
        int "Nand page size in bytes"
        default 2048

    config MTD_SUBPAGE
        bool "Nand subpage support"
        default y

    config MTD_SUBPAGESIZE
        int "Nand subpage size in bytes"
        depends on MTD_SUBPAGE
        default 512

    config MTD_PEBSIZE
        int "Physical Erase Block (PEB) Size in KiB"
        default 128
endmenu
endif

if MMC_INFO
source "image/mmc/Config.in"
endif

endmenu
```

## image/mmc/Config.in
```kconfig
menu "mmc iformation"
	
config MMC_HOSTDEVICE
    string "mmc device path onto host"
    default "mmcblk0"
config MMC_DEVICE
    string "mmc device path onto target"
    default "mmcblk1"
endmenu
```

## init/Config.in
```kconfig
menu "system initialization"
choice 
    prompt "init system"
    default INIT_BUSYBOX if BUSYBOX
    default SYSTEMD if FHS_ANDROID
    default INIT_GNU

    config INIT_BUSYBOX
        bool "busybox init"
        depends on BUSYBOX
        select INITTAB

    config INIT_GNU
        bool "linux utils init"
        depends on GNU
        select INITTAB

    config SYSTEMD
        bool "new systemd start system"

endchoice

config INITTAB
    bool

config INITTAB_FILE
    string "inittab file"
    default "init/config/inittab.default"
    depends on INITTAB
    
config SYSTEMV_STARTUP
    bool "systemV startup system"
    depends on INITTAB

if SYSTEMV_STARTUP

    config RCS_FILE
        string "rcS starting file path"
        default "init/config/rcS.default"

endif

endmenu
```

## kernel/Config.in
```kconfig
menu "Kernel Configuration"

choice
	prompt "Kernel version"
	config LINUX_STD
		bool "Linux standard"
		select LINUX

	config LINUX_LINARO
		bool "Linux from Linaro Team"
		depends on LINARO
		select LINUX

	config KERNEL_CUSTOM
		bool "customized Linux "

	config KERNEL_HEADERS
		bool "do not build kernel just install headers files"
		select KERNEL_HEADERS_MOIFIED

	config RTEMS
		bool "RTEMS : Open Source RTOS"
		help
			http://www.rtems.org/

endchoice

config LINUX
    bool
	prompt "Is Linux kernel" if KERNEL_CUSTOM

config KERNEL
    string
    default "linux" if LINUX
    default "rtems" if RTMES
    prompt "Kernel name" if KERNEL_CUSTOM

config KERNEL_VERSION
    string
    depends on LINUX
    prompt "kernel version number" if KERNEL_CUSTOM || LINUX_LINARO
    default "3.7.1"

config KERNEL_CUSTOM_URL
    string "linux source tree URL (compressed file or git repository)"
    default "git://git.kernel.org/linux/kernel/git/arm/arm-soc.git"
    depends on KERNEL_CUSTOM

config KERNEL_DEFCONFIG
    string "default configuration file"
    default "kernel/config/u8500_defconfig"

config KERNEL_IMAGE
    string "kernel image name"
    default "uImage" if U_IMAGE
    default "zImage"

config KERNEL_RAMADDR
	hex "Kernel RAM address loading"
	default 0x00100000 if BOARD_SNOWBALL

menu "Kernel boot configuration"
config KERNEL_CMDLINE_1
	string "Command Line"
	default "vmalloc=300M mem=128M@0 mali.mali_mem=32M@128M hwmem=168M@160M" if BOARD_SNOWBALL
	default ""

config KERNEL_CMDLINE_2
	string "Command Line continue"
	default "mem=48M@328M mem_issw=1M@383M mem=640M@384M" if BOARD_SNOWBALL
	default ""

config KERNEL_CMDLINE_3
	string "Command Line continue"
	default ""
endmenu

config KERNEL_HEADERS_MOIFIED
	bool "sabotage : kernel headers files cleaned"
	help
		https://github.com/sabotage-linux/sabotage

config BOOTDIR
    string
    default "system/boot" if FHS_ANDROID
    default "boot" if FHS_LINUX

menu "external drivers"
config DRIVER_MALI
	bool 
	prompt "Mali GPU driver" if MALI
	
endmenu
endmenu
```

## system/Config.in
```kconfig
menu "system applications and libraries"
source "system/init/Config.in"
source "system/lowlevel/Config.in"
source "system/security/Config.in"
source "system/framework/Config.in"
source "system/database/Config.in"
source "system/server/Config.in"
source "system/disk/Config.in"
source "system/multimedia/Config.in"
menuconfig DEV
	bool "Development tools"
if DEV
source "system/dev/Config.in" 
endif
endmenu
```

## system/base/Config.in
```kconfig
menu "Environment tools"
choice
    default BUSYBOX

    prompt "Environment selection"
    config BUSYBOX
        bool "busybox"

    config GNU
        bool "gnu"

    config DALVIK
        bool "Android Dalvik VM"

endchoice
endmenu
```

## system/database/Config.in
```kconfig
menu "Databases"
config DB_GDBM_SP
	bool "GDBM : The GNU dbm"

config DB_SQLITE_SP
	bool "SQLite : The embedded SQL DB"
endmenu
```

## system/disk/Config.in
```kconfig
menu "disk tools"
config DISK_EXT2PROGS_SP
	bool "ext2/3/4 file system tools"
	
endmenu
```

## system/filecompressor/Config.in
```kconfig
menu "files compressor libraries and utilities"
config ZLIB
    bool
    prompt "zip compression library" if SHOW_ALL
    help
        http://zlib.net/

endmenu
```

## system/fileparser/Config.in
```kconfig
menu "files parser libraries"
config EXPAT
    bool
    prompt "xml fileparser in C language" if SHOW_ALL
    help
        http://expat.sourceforge.net/

config LIBFFI
    bool
    prompt "A Portable Foreign Function Interface Library " if SHOW_ALL
    help
        http://sourceware.org/libffi/

endmenu
```

## system/framework/Config.in
```kconfig
menu "middleware"
source "system/framework/ipc/Config.in"
source "system/framework/fileparser/Config.in"
source "system/framework/filecompressor/Config.in"
source "system/framework/images/Config.in"
source "system/framework/video/Config.in"

comment "graphic framework"
config FW_NCURSES_SP
	bool "ncurses graphic library"
	default y if LSB
	help
		http://www.gnu.org/software/ncurses/

config FW_SDL_SP
	bool "sdl graphic library"
	help
		http://www.libsdl.org

endmenu
```
