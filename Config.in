## system/framework/filecompressor/Config.in
```kconfig
menu "files compressor libraries and utilities"
config FW_ZLIB_SP
    bool
    prompt "zlib : zip compression library" if SHOW_ALL
    default y if LSB
    help
        http://zlib.net/

config FW_BZIP2_SP
    bool
    prompt "bzip2 : bz2 compression library" if SHOW_ALL
    default y
    help
        http://zlib.net/

endmenu
```

## system/framework/fileparser/Config.in
```kconfig
menu "files parser libraries"
config FW_EXPAT
    bool
    prompt "expat : xml fileparser in C language" if SHOW_ALL
    help
        http://expat.sourceforge.net/

config FW_LIBTOOL
    bool
    prompt "libtool : libltdl dynamic link helper" if SHOW_ALL
    help
        http://www.gnu.org/software/libtool/

config FW_LIBFFI
    bool
    prompt "libffi : A Portable Foreign Function Interface Library " if SHOW_ALL
    help
        http://sourceware.org/libffi/

config FW_PCRE_SP
    bool
    prompt "pcre : Perl Compatible Regular Expressions Library " if SHOW_ALL
    help
        http://pcre.org

endmenu
```

## system/framework/images/Config.in
```kconfig
menu "images manipulation libraries"

config FREETYPE
	bool "Font manager"
	help
		http://www.freetype.org/

config PIXMAN
    bool
    prompt "pixel manipulation library" if SHOW_ALL
    help
        http://pixman.org/

config LIBPNG
    bool
    prompt "png Portable Network Graphics library" if SHOW_ALL
    select FW_ZLIB_SP
    help
        http://www.libpng.org/pub/png/

config LIBJPEG
    bool
    prompt "jpeg file library" if SHOW_ALL
    help
        http://www.libjpeg-turbo.org/

endmenu
```

## system/framework/ipc/Config.in
```kconfig
menu "Inter Process Communication and protocol libraries"

config WAYLAND_LIB
	bool "Wayland graphic protocol"
	depends on GRAPHICS

config FUSIONDALE
	bool "FusionDale IPC library (DirectFB)"
	default y if DIRECTFB
	select LINUX_FUSION

config FW_IPC_LIBEVENT_SP
	bool

config FW_IPC_LIBEVENT
	bool
	prompt "libevent – an event notification library " if SHOW_ALL
	select FW_IPC_LIBEVENT_SP

config LINUX_FUSION
	bool
	prompt "fusion linux's driver" if SHOW_ALL

endmenu
```
