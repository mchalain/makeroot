## system/framework/video/Config.in
```kconfig
menu "video framework"
config FW_VIDEO_XVID
	bool "XvidCore the XviD codec"
	help
		http://www.xvid.com

config FW_VIDEO_X264
	bool "x264  H.264/MPEG-4 AVC compression format"
	help
		http://www.videolan.org/developers/x264.html

config FW_AUDIO_AACPLUS
	bool "AAC+ audio codec"
	help
		

config FW_VIDEO_FFMPEG
	bool "FFmpeg the mpeg format framework"
	help
		http://ffmpeg.org/

endmenu
```

## system/images/Config.in
```kconfig
menu "images manipulation libraries"
config PIXMAN
    bool
    prompt "pixel manipulation library" if SHOW_ALL
    help
        http://pixman.org/

config LIBPNG
    bool
    prompt "png Portable Network Graphics library" if SHOW_ALL
    select ZLIB
    help
        http://www.libpng.org/pub/png/

endmenu
```

## system/init/Config.in
```kconfig
menu "system initialization"
choice 
    prompt "init tool"
    default INIT_BUSYBOX if BUSYBOX
    default SYSTEMD if FHS_ANDROID
    default INIT_GNU

    config INIT_BUSYBOX
        bool "busybox init"
        depends on BUSYBOX
        select INITTAB

    config INIT_GNU
        bool "linux utils init"
        depends on GNU
        select INITTAB

    config SYSTEMD
        bool "new systemd start system"

endchoice

config INITTAB
    bool

config INITTAB_FILE
    string "inittab file"
    default "inittab.default"
    depends on INITTAB

if INITTAB
choice
	prompt "type of startup scripts"
	
	config INIT_SYSTEMV
		bool "systemV startup system"
		depends on INITTAB
		select RCS_FILE

	config INIT_MAKEROOT
		bool "simple init scripts"
		depends on INITTAB
		select RCS_FILE
		help
			This scripts are defined for a simple configuration
			No optimization are available
endchoice
endif

config RCS_FILE
	bool

config RCS_FILENAME
	string 
	prompt "rcS services starting file path" if RCS_FILE
	default "imrscripts/rcS" if INIT_MAKEROOT
	default "config/rcS.default"

config RC0_FILENAME
	string 
	prompt "rc0 services stoping file path" if RCS_FILE
	default "imrscripts/rc0" if INIT_MAKEROOT
	default "config/rc0.default"

if INIT_MAKEROOT
menu  "Select scripts"
	
	config INIT_MR_TREE
		bool "create generated file inside /tmp"
		depends on TMPFS
		
	config INIT_MR_UDEVD
		bool "start udevd for devices management"
		depends on UDEV_DAEMON

	menuconfig INIT_MR_NETWORK
		bool "init the Network"
		select INETSCRIPTS

		menuconfig INIT_MR_BUSYBOX_SERVER
			bool "Busybox servers"
			depends on INIT_MR_NETWORK && BUSYBOX

			config INIT_MR_TELNET
				bool "start telnet server"
				depends on INIT_MR_BUSYBOX_SERVER

			config INIT_MR_FTPD
				bool "start ftp server"
				depends on INIT_MR_BUSYBOX_SERVER

			config INIT_MR_HTTPD
				bool "start http server"
				depends on INIT_MR_BUSYBOX_SERVER

			config INIT_MR_NTPD
				bool "start ntp server"
				depends on INIT_MR_BUSYBOX_SERVER

		config INIT_MR_RPC
			bool "start portmap or rpcbind"
			depends on INIT_MR_NETWORK && SERVER_RPC

		config INIT_MR_NFSD
			bool "start nfsd"
			depends on INIT_MR_NETWORK && SERVER_NFS

		config INIT_MR_SSHD
			bool "start sshd secure shell server"
			depends on INIT_MR_NETWORK && SECURITY_OPENSSH_SP

		config INIT_MR_PROFTPD
			bool "start proftpd powerfull ftp server"
			depends on INIT_MR_NETWORK && SERVER_PROFTP_SP

		config INIT_MR_LIGHTTPD
			bool "start lighttpd light and fast http server"
			depends on INIT_MR_NETWORK && SERVER_LIGHTTPD_SP

		config INIT_MR_USHARE
			bool "start ushare upnp/dlna server"
			depends on INIT_MR_NETWORK && SERVER_USHARE_SP

endmenu
endif

config INIT_LSB
    bool "Linux Standard Base"
    default y if LSB
    default n
    help
		init-functions script
		see linuxbase.org

endmenu
```

## system/ipc/Config.in
```kconfig
menu "Inter Process Communication and protocol libraries"

config WAYLAND_LIB
	bool "Wayland graphic protocol"
	depends on GRAPHICS

config FUSIONDALE
	bool "FusionDale IPC library (DirectFB)"
	default y if DIRECTFB
	select LINUX_FUSION

config LINUX_FUSION
	bool
	prompt "fusion linux's driver" if SHOW_ALL

endmenu
```

## system/libc/Config.in
```kconfig
menu "C language library : libc"
choice
    default LIBC_TOOLCHAIN

    prompt "libc version"
    config LIBC_TOOLCHAIN
        bool "the libc from the toolchain"

    config LIBC_GLIBC
        bool "The Gnu Libc"
        select LIBC_NLS
        select LIBC_NSL
        select LIBC_RCP
        select LIBC_LDSO
        select LIBC_RT

    config LIBC_UCLIBC
        bool "uClibc"
        select LIBC_NLS
        select LIBC_NSL
        select LIBC_RCP
        select LIBC_LDSO
        select LIBC_RT

    config LIBC_NEWLIB
        bool "newlib RedHat embedded libc"

    config LIBC_BIONIC
        bool "bionic the Google embedded libc"
        select LIBC_NLS
        select LIBC_NSL
        select LIBC_RCP
        select LIBC_LDSO
        select LIBC_RT

	config LIBC_MUSL_SP
		bool "musl embedded libc for linux"
        select LIBC_LDSO
        select LIBC_NSL
        select LIBC_RT

endchoice

config LIBC_NLS
	bool
	prompt "libc supports Native Language NLS" if LIBC_TOOLCHAIN
config LIBC_NSL
	bool
	prompt "libc supports Network Services Library " if LIBC_TOOLCHAIN
	help
		gethostbyname getservbyname, getpwnam
		This library may be a part of libc
config LIBC_RCP
	bool
	prompt "libc supports Remote Command Protocol RCP" if LIBC_TOOLCHAIN
config LIBC_LDSO
	bool
	prompt "libc supports Dynamic Linker LDSO (-ldl)" if LIBC_TOOLCHAIN
config LIBC_RT
	bool
	prompt "libc supports RealTime functions" if LIBC_TOOLCHAIN
	
config LINARO_RUNTIME
	bool "Linaro Runtime libraries"
	default y if LINARO && LIBC_TOOLCHAIN

config LIBC_GLIBC_VERSION
    string "version"
    default 2.17
    depends on LIBC_GLIBC

config LIBC_GLIBC_DEFCONFIG
    string "config file"
    default libc/config/glibc_defconfig
    depends on LIBC_GLIBC

config LIBC_UCLIBC_VERSION
    string "version"
    default 0.9.33
    depends on LIBC_UCLIBC

config LIBC_UCLIBC_DEFCONFIG
    string "config file"
    default libc/config/uclibc_defconfig
    depends on LIBC_UCLIBC

config LIBC_NEWLIB_VERSION
    string "version"
    default linaro-2.1.0-2014.02 if LINARO
    default 2.0.0
    depends on LIBC_NEWLIB

config LIBC_NEWLIB_CONFIGURE
    string "configure options"
    default "--disable-newlib-supplied-syscalls"
    depends on LIBC_NEWLIB

config PATCHELF
	bool "patchelf : binary utility"
	help
	patchelf is a small utility to modify the dynamic linker inside a binary.
	Example need to launch /usr/bin/foobar but foobar must load 
	/usr/lib/mylibc/libc.so instead /lib/ld.so

endmenu
```

## system/lowlevel/Config.in
```kconfig
menu "lowlevel managers"

source "system/lowlevel/manager/Config.in"
source "system/lowlevel/network/Config.in"

comment  "Graphics screen support"
source "system/lowlevel/graphics/Config.in"

comment "Audio support"
source "system/lowlevel/audio/Config.in"
endmenu
```

## system/lowlevel/graphics/Config.in
```kconfig
menuconfig GRAPHICS
    bool "Graphics screen support"

if GRAPHICS

config EGL
    bool "Open EGL 3D graphic support"
if EGL
source "system/lowlevel/graphics/egl/Config.in"
endif

config FRAMEBUFFER
    bool  "Video Framebuffer support"
    help
		The framebuffer is simpler video memory access to display image.
		This feature doesn't build any library but it's kernel dependante.
		Please check the kernel configuration for the support.

config DRM
	bool "Direct Rendering Manager"
	depends on UDEV_DEAMON
	help
		The Direct Renderer Manager is a Kernel feature to enable.
		This configuration activates the libdrm build.

source "system/lowlevel/graphics/system/Config.in"

if DIRECTFB
source "system/lowlevel/graphics/directFB/Config.in"
endif

if X11
source "system/lowlevel/graphics/X11/Config.in"
endif

if WAYLAND
source "system/lowlevel/graphics/wayland/Config.in"
endif


endif
```

## system/lowlevel/graphics/system/Config.in
```kconfig
choice
    prompt "Graphic System"

    config FRAMEBUFFER_ONLY
        tristate "Frame Buffer  only"
        select FRAMEBUFFER
        
    config DIRECTFB
        tristate "DirectFB"
        select FRAMEBUFFER

    config X11
        tristate "X11 server"

    config WAYLAND
        tristate "Wayland"
        select FW_LIBFFI
        select FW_EXPAT
        select WAYLAND_LIB

endchoice

if WAYLAND
comment "Wayland configuration"

config WAYLAND_VERSION
    string "Wayland version"
    default "1.1.0"

choice
    prompt "Compositor"
    default WESTON

    config WESTON
        bool "Weston default Wayland Compositor"
        select LIBXKBCOMMON
        select PIXMAN
        select LIBPNG
        select LIBJPEG
        select CAIRO

endchoice

config WESTON_OPTIONS
    string "Weston autogen options"
    depends on WESTON
    default "--disable-libunwind" if !LIBUNWIND

endif

config CAIRO
	bool
	prompt "Cairo graphic rendering" if SHOW_ALL
	select FREETYPE

if DIRECTFB
config DIRECTFB_MULTIAPPS
	bool "DirectFB with multi applications"
	default y
	select LINUX_FUSION
endif

config LIBXKBCOMMON
    bool
    prompt  "libxkbcommon translating evdev keycodes to keysyms" if SHOW_ALL
```

## system/lowlevel/manager/Config.in
```kconfig
menu "devices manager"
	config UDEV_DEAMON
		bool
		default y if DEV_UDEV

	config MTDEV_DEAMON
		bool "mtdev multitouch device protocol"

	config MR_HOTPLUG
		bool "simple hotplug scripts"

endmenu
```

## system/lowlevel/network/Config.in
```kconfig
menu "network manager"

	config ETHERNETCONFIG
		bool

	config ETHTOOL
		bool "kernel ethernet configuration tool"

    config INETSCRIPTS
		bool "simple ethernet configuration file"
		select ETHERNETCONFIG

choice
	prompt "ethernet configuration type"
	depends on ETHERNETCONFIG
	default IPUDHCPC if BUSYBOX
	default IPSTATIC

	config IPSTATIC
		bool "Static IP address"
	config IPDHCPCD
		bool "Dynamic IP address by GNU dhcpcd"
	config IPUDHCPC
		bool "Dynamic IP address by Busybox dhcpc"
		depends on BUSYBOX
endchoice

config IPADDRESS
	string
	prompt "IP address" if IPSTATIC
	default "dhcpcd" if IPDHCPCD
	default "udhcpc" if IPUDHCPC
	default "0.0.0.0"

config NETMASK
	string
	prompt "INet mask" if IPSTATIC
	default "255.255.255.255" if IPSTATIC
	default ""

config GATEWAY
	string
	prompt "Gateway" if IPSTATIC
	default "255.255.255.255" if IPSTATIC
	default ""

config NAMESERVER1
	string "domain name server 1"
config NAMESERVER2
	string "domain name server 2"
	
config ETHMODULE
	string "kernel module name"
	depends on INETSCRIPTS
	help
		leave empty if kernel support inside

endmenu
```

## system/multimedia/Config.in
```kconfig
menu "Multimedia"
config MM_MPD
	bool "mpd - Music Player daemon"
	depends on FW_GLIB

config MM_LAME_SP
	bool "lame - MP3 audio encoder"

config MM_MPG123_SP
	bool "mpg123 - MP3 audio player"
	help
		http://www.mpg123.de/
endmenu
```

## system/security/Config.in
```kconfig
menu "security"
config SECURITY_OPENSSL_SP
	bool "openssl: SSL/TLS toolkit"
	help
		http://www.openssl.org

config SECURITY_OPENSSH_SP
	bool "openssh: remote terminal over ssh"
	select SECURITY_OPENSSL_SP
	help
		http://www.openssh.com/

config SECURITY_GSSDP
	bool
	depends on FW_GLIB

endmenu
```

## system/server/Config.in
```kconfig
menu "network server"
config SERVER_CUPS_SP
	bool "CUPS printer server"
	help
		http://www.cups.org

config SERVER_PROFTP_SP
	bool "ProFTP file transfert server"
	help
		http://www.proftpd.org

config SERVER_NFS
	bool "NFS Network File System client/server"
	select FW_IPC_LIBEVENT
	select SERVER_RPC
	select SERVER_NFSUTILS_SP
	select SERVER_NFSIDMAP_SP
	help
		http://linux-nfs.org

if SERVER_NFS
config SERVER_NFSUTILS_SP
	bool

config SERVER_NFSIDMAP_SP
	bool
endif

config SERVER_SMB
	bool "Microsoft Network File System client/server"
	select FW_IPC_LIBEVENT
	select SERVER_CIFSUTILS_SP
	help
		http://www.samba.org

if SERVER_SMB
config SERVER_CIFSUTILS_SP
	bool
config SERVER_SAMBA_SP
	bool "Old Samba version"
endif

config SERVER_RPC
	bool
	select SERVER_RPCBIND_SP
	select SERVER_LIBTIRPC_SP

if SERVER_RPC
config SERVER_LIBTIRPC_SP
	bool

config SERVER_RPCBIND_SP
	bool

config SERVER_TCPW_SP
	bool
	prompt "tcp_wrapper" if SERVER_RPCBIND_SP

endif

menu "Authentification server/client"
config SERVER_NIS
	bool "NIS/NIS+ authentification client"
endmenu

config SERVER_LIGHTTPD_SP
	bool "Lighttpd : a light HTTP server"

menuconfig UPNP
	bool "UPnP servers"

config SERVER_USHARE_SP
	bool "uShare : DLNA Media Server"
	depends on UPNP
	select SERVER_LIBUPNP_SP
	help
		http://ushare.geexbox.org/

config SERVER_MEDIATOMB_SP
	bool "MediaTomb : DLNA Media Server"
	depends on UPNP
	select SERVER_LIBUPNP_SP
	help
		http://mediatomb.cc/

config SERVER_GUPNP_SP
	bool "gupnp : Gnome Universable Plug and Play framework"
	depends on UPNP
	depends on FW_GLIB
	select SERVER_LIBSOUP
	select SECURITY_GSSDP
	help
		https://wiki.gnome.org/action/show/Projects/GUPnP

config SERVER_LIBDLNA_SP
	bool
	prompt "libdlna : DLNA library framework" if SERVER_USHARE_SP
	depends on UPNP
	depends on FW_VIDEO_FFMPEG
	help
		http://libdlna.geexbox.org/

config SERVER_LIBUPNP_SP
	bool
	prompt "libupnp : Portable Universable Plug and Play framework" if SHOW_ALL
	depends on UPNP
	help
		pupnp is the replacement of the original libupnp
		http://pupnp.sourceforge.net/

config SERVER_LIBSOUP
	bool
	prompt "libsoup : HTTP client/server library" if SHOW_ALL
	depends on UPNP
	depends on FW_GLIB
	help
		https://wiki.gnome.org/action/show/Projects/libsoup

config SECURITY_GSSDP
	bool
	depends on FW_GLIB

endmenu
```

## system/tree/Config.in
```kconfig
menu "System Type"

choice
    default FHS_LINUX

    prompt "System Hierarchy"
    config FHS_LSB
        bool "Linux Standard Base"
		help
			Linux Standard Base defines the hierarchy

    config FHS_ANDROID
        bool "Android system"

endchoice

config SYSTEM
    string
    default "usr" if FHS_LSB
    default "system" if FHS_ANDROID

config CONFIGDIR
    string
    default "etc" if FHS_LSB
    default "etc" if FHS_ANDROID

if FHS_LSB
config LSB
	bool "Complete support of Linux Standard Base"
	default n
source "system/tree/fhs/Config.in"
endif

endmenu
```

## system/tree/android/Config.in
```kconfig
menu "File System Hierarchy"

choice
    prompt "System Hierarchy"
    config FHS_LINUX
        bool "Linux standard"
        default y
        select TREE_BOOT
        select TREE_DEFROOT
        select TREE_HOME
        select TREE_OPT
        select TREE_ETC
        select TREE_USR
        select TREE_VAR
        select TREE_MEDIA
        select TREE_SHARE
        select TREE_MODULES
        select TREE_FONTS

    config FHS_ANDROID
        bool "Android system"
        select TREE_BOOT
        select TREE_DEFROOT
        select TREE_HOME
        select TREE_OPT
        select TREE_ETC
        select TREE_USR
        select TREE_VAR
        select TREE_MEDIA
        select TREE_SHARE
        select TREE_MODULES
        select TREE_APP
        select TREE_FONTS

endchoice

config SYSTEM
    string
    default "fhs" if FHS_LINUX
    default "android" if FHS_ANDROID

config TREE_BOOT
    bool

config TREE_DEFROOT
    bool

config TREE_HOME
    bool

config TREE_OPT
    bool

config TREE_ETC
    bool

config TREE_USR
    bool

config TREE_VAR
    bool

config TREE_MEDIA
    bool

config TREE_SHARE
    bool

config TREE_MODULES
    bool

config TREE_FONTS
    bool

config TREE_APP
    bool

endmenu
```
