## system/tree/fhs/Config.in
```kconfig
menu "File System Hierarchy"

choice
    prompt "device node populating"
    default DEV_STATIC

    config DEV_STATIC
        bool "static device nodes"

    config DEV_TMPDEV_ONLY
        bool "device file system only"
        select DEV_TMPDEV
    
    config DEV_UDEV
        bool "udev daemon"
        select DEV_TMPDEV

    config DEV_MDEV
        bool "mdev daemon"
        select DEV_TMPDEV
        depends on BUSYBOX

endchoice

config DEV_TMPDEV
    bool

config FHS_BOOT
    bool
    default y

config FHS_USERS
    bool "add users groups files database"
    default y

config USR_LOCAL
    bool "add /usr/local directory ans sub-directories"

config VARSUBDIRS
    bool "add /var sub-directories"

config MEDIADIRS
    bool "add /media directory ans sub-directories"

config MNTDIRS
    bool "add /mnt directory ans sub-directories"

config TMPFS
    bool "create /tmp virtual files system"

config FSTAB
	bool "install /etc/fstab file"
	default y

menu "Files System Table"
	depends on FSTAB
config FSTAB_PROC
    bool "add entry in fstab for /proc"

config FSTAB_SYS
    bool "add entry in fstab for /sys"

config FSTAB_DEV
    bool "add entry in fstab for /dev"
    depends on DEV_TMPDEV

config FSTAB_TMP
    bool "add entry in fstab for /tmp"
    depends on TMPFS

config FSTAB_DEVPTS
    bool "add entry in fstab for /dev/pts"

config FSTAB_DEVSHM
    bool "add entry in fstab for /dev/shm"

config FSTAB_DEVSHM_SIZE
    int "size of the shm file system"
    default 33554432
    depends on FSTAB_DEVSHM

config FSTAB_BOOTVFAT
    bool "add entry in fstab for /boot to see the boot partition"
    depends on FHS_BOOT

endmenu

endmenu
```

## tools/Config.in
```kconfig
menu "external tools suppliers"

menuconfig LINARO
	bool "linaro consortium support"
 
config LINARO_VERSION
	string "Linaro release number"
	depends on LINARO 
	default "14.05"

config LINARO_LSK
	bool "Linaro stable Long Support Kernel"
	depends on LINARO && LINUX_LINARO
	default y

menuconfig SOURCERY
	bool "Code Sourcery tools support"

config BOARD_SNOWBALL_RIFF
  bool "riff flasher for Snowball"
  depends on BOARD_SNOWBALL
  default n

endmenu
```

## tools/gcc/Config.in
```kconfig
menu "Toolchain"
choice
	prompt "toolchain select"
		default TOOLCHAIN_CUSTOM

	config TOOLCHAIN_LINARO
		bool "Linaro Toolchain"
		select TOOLCHAIN_GCC
		depends on ARM && LINARO

	config TOOLCHAIN_BARE_METAL
		bool "bare-metal Toolchain"
		select TOOLCHAIN_GCC
		depends on ARM

	config TOOLCHAIN_SOURCERY_LINUX
		bool "Code Sourcery Toolchain for GNU/Linux"
		select TOOLCHAIN_GCC

	config TOOLCHAIN_SOURCERY_EABI
		bool "Code Sourcery Toolchain for EABI (with newlib)"
		select TOOLCHAIN_GCC

	config TOOLCHAIN_CUSTOM
		bool "custom Toolchain"

endchoice

choice
	prompt "compiler name" if TOOLCHAIN_CUSTOM
config TOOLCHAIN_GCC
	bool "GCC"
config TOOLCHAIN_LLVM
	bool "LLVM"
config TOOLCHAIN_ARM
	bool "ARM"
endchoice

config TOOLCHAIN_GCC_VERSION
	depends on TOOLCHAIN_GCC
	string "C Compiler version"
	default "4.8" if TOOLCHAIN_LINARO
	default "4.6"

config CROSS_COMPILE
    string "Cross Compilation tools suffix"
    default "arm-linux-gnueabihf" if TOOLCHAIN_LINARO
    default "arm-linux-gnueabi" if TOOLCHAIN_LINARO
    default "arm-none-eabi" if TOOLCHAIN_SOURCERY_EABI
    default "arm-none-linux-gnueabi"

menuconfig TOOLCHAIN_INSTALLATION
	bool "use already installed Toolchain"

config TOOLCHAIN_PATH
    string "Cross Compilation toolchain Path"
    depends on TOOLCHAIN_INSTALLATION
    default "/opt/linaro" if TOOLCHAIN_LINARO
    default "/opt/armtools/toolchain" if ARM
    default "/opt/mipstools/toolchain" if MIPS

config TOOLCHAIN_INSTALL
	bool
	default y if !TOOLCHAIN_INSTALLATION

endmenu
```

## tree/Config.in
```kconfig
menu "System Type"

choice
    default FHS_LINUX

    prompt "System Hierarchy"
    config FHS_LINUX
        bool "Linux standard"

    config FHS_ANDROID
        bool "Android system"

endchoice

config SYSTEM
    string
    default "fhs" if FHS_LINUX
    default "android" if FHS_ANDROID

if FHS_LINUX
source "tree/fhs/Config.in"
endif

endmenu
```
